R.S PC 0xc03903c8
R.S R14 0x00000000
R.S CPSR 0x20000053
R.S R13 0xd3acbe0c
R.S R12 0x00000000
R.S R11 0xc1ca071c
R.S R10 0xc1ca077c
R.S R9 0xc0ae7dd8
R.S R8 0x00000000
R.S R7 0x00000000
R.S R6 0x00000000
R.S R5 0x00000000
R.S R4 0x00000000
R.S R3 0x00000000
R.S R2 0x00000350
R.S R1 0xc5afffe8
R.S R0 0xce291be0
