R.S PC 0x0000007f961cf9e8
R.S ELR 0x0000007f963d4320
R.S SP 0x0000007fdb157510
R.S X29 0x0000007fdb157510
R.S X28 0x0000000000001404
R.S X27 0x0000000000000018
R.S X26 0x0000007f96090008
R.S X25 0x0000007f9609202c
R.S X24 0x0000007fdb157fa0
R.S X23 0x0000000000000000
R.S X22 0x0000000000000000
R.S X21 0x0000000000000001
R.S X20 0x0000007f96092000
R.S X19 0x0000007f960a2000
R.S X18 0x0000000000000002
R.S X17 0x0000007f961cf880
R.S X16 0x0000007f963e6ee0
R.S X15 0x0000000000000003
R.S X14 0x00000000000000c8
R.S X13 0x0000007f96259000
R.S X12 0x00000000000000c7
R.S X11 0x00000000004c4b40
R.S X10 0x0000000000000040
R.S X9 0x0000000000000004
R.S X8 0x0000007f96092540
R.S X7 0x0000000000000000
R.S X6 0x000000000000003f
R.S X5 0x0000000000000040
R.S X4 0xffffffffffffffd0
R.S X3 0x00000000000013f0
R.S X2 0x0000000000000eb0
R.S X1 0x0000000000000000
R.S X0 0x0000007f9609202c
